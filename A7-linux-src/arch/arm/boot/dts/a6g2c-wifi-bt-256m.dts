/*
 * Copyright (C) 2015 Freescale Semiconductor, Inc.
 *
 * This program is free software; you can redistribute it and/or modify
 * it under the terms of the GNU General Public License version 2 as
 * published by the Free Software Foundation.
 */

#include "a6g2c-base-256m.dts"

&flexcan2 {
	status = "disabled";
};

&uart2 {
	fsl,uart-has-rtscts;
};

&usdhc2 {
	status = "okay";
};

&iomuxc {
	pinctrl-0 = <&pinctrl_hog_1 &pinctrl_wifi &pinctrl_blueth>;
};
