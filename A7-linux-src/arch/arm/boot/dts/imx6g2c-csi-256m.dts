/*
 * Copyright (C) 2015 Freescale Semiconductor, Inc.
 *
 * This program is free software; you can redistribute it and/or modify
 * it under the terms of the GNU General Public License version 2 as
 * published by the Free Software Foundation.
 */

#include "imx6g2c-800x480-256m.dts"


&uart6 {
	status = "disabled";
};

&adv7180 {
	status = "okay";
};

&csi {
	status = "okay";
};

&ecspi1 {
	status = "disabled";
};
